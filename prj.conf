## CMakeLists.txt
```
# SPDX-License-Identifier: Apache-2.0

cmake_minimum_required(VERSION 3.20.0)

find_package(Zephyr REQUIRED HINTS $ENV{ZEPHYR_BASE})
project(synchronization)

include_directories(src/)

target_sources(app PRIVATE src/main.c)
target_sources(app PRIVATE src/vibration_motor.c)
```

## prj.conf
```kconfig
#
CONFIG_STDOUT_CONSOLE=y

# NEWLIB C
CONFIG_NEWLIB_LIBC=y
CONFIG_NEWLIB_LIBC_FLOAT_PRINTF=y

# enable to use thread names
CONFIG_THREAD_NAME=y
CONFIG_SCHED_CPU_MASK=y
CONFIG_NRFX_TIMER0=y
CONFIG_NRFX_TIMER1=y
CONFIG_NRFX_SYSTICK=y

# Enable nrfx SAADC driver
CONFIG_NRFX_SAADC=y
CONFIG_I2C=y
```

## src/hackster_logo.h
```c
/*
 * DON'T COPY THE VARIABLE NAME/DEFINITION JUST THE ARRAY df!
 */

#define hackster_logo_width 128
#define hackster_logo_height 32

//Hackter.io logo
static const unsigned char hackster_logo[] = {
  0x00,0x00,0x00,0x00,0x00,0x00,0x00,0x00,0x00,0x00,0x00,0x00,0x00,0x00,0x00,
  0x00,0x00,0xe0,0x03,0x00,0x00,0x00,0x00,0x00,0x00,0x00,0x00,0x00,0x00,0x00,
  0x00,0x00,0x00,0xfc,0x1f,0x00,0x00,0x00,0x00,0x00,0x00,0x00,0x00,0x00,0x00,
  0x00,0x00,0x00,0x00,0xff,0x7f,0x00,0x00,0x00,0x00,0x00,0x00,0x00,0x00,0x00,
  0x00,0x00,0x00,0x00,0x80,0xff,0xff,0x01,0x00,0x00,0x00,0x00,0x00,0x00,0x00,
  0x00,0x00,0x00,0x00,0x00,0xc0,0xff,0xff,0x03,0x00,0x00,0x00,0x00,0x00,0x00,
  0x00,0x00,0x00,0x00,0x00,0x00,0xe0,0xff,0xdf,0x07,0x00,0x00,0x00,0x00,0x00,
  0x00,0x00,0x00,0x00,0x00,0x00,0x00,0xf0,0xff,0xcf,0x07,0x00,0x00,0x00,0x00,
  0x00,0x00,0x00,0x00,0x00,0x00,0x00,0x00,0xf8,0xcf,0xc3,0x0f,0x00,0x00,0x00,
  0x00,0x00,0x00,0x00,0x00,0x00,0x00,0x00,0x00,0xf8,0xc3,0xc3,0x1f,0xe0,0x00,
  0x00,0x00,0x30,0x00,0x00,0x00,0x00,0x00,0x06,0x00,0xfc,0xc3,0xc3,0x1f,0xe0,
  0x00,0x00,0x00,0x30,0x00,0x80,0x01,0x00,0x00,0x06,0x00,0xfc,0xcf,0xc3,0x1f,
  0xe0,0x00,0x00,0x00,0x30,0x00,0x80,0x01,0x00,0x00,0x00,0x00,0xfe,0xff,0xc3,
  0x3f,0xe0,0x00,0x00,0x00,0x30,0x00,0x80,0x01,0x00,0x00,0x00,0x00,0xfe,0xc1,
  0xff,0x3f,0xe0,0x0f,0x3c,0xf0,0x31,0xc6,0xe7,0xc7,0x87,0x0d,0x86,0x1f,0x7e,
  0x00,0xc0,0x3f,0xe0,0x1f,0x7e,0xf8,0x33,0xe7,0xee,0xe7,0x8f,0x0f,0xc6,0x3f,
  0xfe,0x03,0xc0,0x3f,0xe0,0x38,0xe3,0x1c,0xb3,0x63,0x8c,0x71,0x8c,0x03,0xe6,
  0x70,0xfe,0x03,0x00,0x3e,0xe0,0x30,0xe0,0x0c,0xf0,0xe1,0x80,0x31,0x98,0x01,
  0x66,0x60,0xfe,0xff,0x83,0x3f,0xe0,0x30,0xfe,0x0c,0xf0,0xc0,0x87,0xf1,0x9f,
  0x01,0x66,0x60,0xfe,0xc3,0xff,0x3f,0xe0,0x30,0xe7,0x0c,0xf0,0x01,0x8e,0x31,
  0x80,0x01,0x66,0x60,0xfc,0xc3,0xf3,0x1f,0xe0,0x30,0xe3,0x1c,0xb3,0x63,0x8c,
  0x71,0x9c,0x01,0xe6,0x70,0xfc,0xc3,0xc3,0x1f,0xe0,0x30,0xf3,0xf8,0x33,0xe7,
  0x8e,0xe7,0x8f,0x31,0xc6,0x3f,0xf8,0xc3,0xc3,0x1f,0xe0,0x30,0xdf,0xf0,0x31,
  0xc6,0x07,0xc7,0x87,0x31,0x86,0x1f,0xf8,0xc3,0xf3,0x0f,0x00,0x00,0x00,0x00,
  0x00,0x00,0x00,0x00,0x00,0x00,0x00,0x00,0xf0,0xf3,0xff,0x07,0x00,0x00,0x00,
  0x00,0x00,0x00,0x00,0x00,0x00,0x00,0x00,0x00,0xe0,0xfb,0xff,0x07,0x00,0x00,
  0x00,0x00,0x00,0x00,0x00,0x00,0x00,0x00,0x00,0x00,0xc0,0xff,0xff,0x03,0x00,
  0x00,0x00,0x00,0x00,0x00,0x00,0x00,0x00,0x00,0x00,0x00,0x80,0xff,0xff,0x01,
  0x00,0x00,0x00,0x00,0x00,0x00,0x00,0x00,0x00,0x00,0x00,0x00,0x00,0xff,0x7f,
  0x00,0x00,0x00,0x00,0x00,0x00,0x00,0x00,0x00,0x00,0x00,0x00,0x00,0x00,0xfc,
  0x1f,0x00,0x00,0x00,0x00,0x00,0x00,0x00,0x00,0x00,0x00,0x00,0x00,0x00,0x00,
  0xe0,0x03,0x00,0x00,0x00,0x00,0x00,0x00,0x00,0x00,0x00,0x00,0x00,0x00,0x00,
  0x00,0x00,0x00,0x00,0x00,0x00,0x00,0x00,0x00,0x00,0x00,0x00,0x00,0x00,0x00,
  0x00,0x00,0x00,0x00,0x00,0x00,0x00,0x00,0x00,0x00,0x00,0x00,0x00,0x00,0x00,
  0x00,0x00
};
```

## src/vibration_motor.h
```c
/********************************************************************************
 * Copyright (c) 2012-2014 Wind River Systems, Inc.
 *
 * SPDX-License-Identifier: Apache-2.0
 ********************************************************************************/
#ifndef VIBRATION_MOTOR_H 
#define VIBRATION_MOTOR_H

#define VIBRATION_MOTOR_ON_SLEEP_TIME	100
#define VIBRATION_MOTOR_OFF_SLEEP_TIME	50

#define VIBRATION_MOTOR			29

void vibration_motor_init(void);
void vibration_motor(uint32_t VibrationCount, uint8_t SleepTime);

#endif
```
